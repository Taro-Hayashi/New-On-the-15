/* x7 left/central: 6 underglow LEDs followed by 28 backlight LEDs. */

#include "split-leds-common.overlay"
#include "nimh-battery-test.overlay"

/*
 * The x7 board carries 34 SK6812, not the 38 of the shield default: one
 * backlight column fewer, four LEDs fewer. The lighting module asserts that
 * led-positions covers exactly chain-length LEDs, so the strip has to be
 * shortened here rather than left at the x8 superset value.
 */
&led_strip {
    chain-length = <34>;
};

&vbatt {
    series-cell-count = <1>;
};

&rgb_ug {
    matrix-columns = <7>;
    matrix-rows = <4>;
    /*
     * The same 34 positions as the standalone config/x7-leds.overlay: the left
     * half of a split sits at the origin of the Studio layouts, exactly where
     * the one-piece board does, so its LED table is unchanged.
     */
    led-positions = <
          114  134   114  225   114  316   836  316   836  225   /* LED1 LED2 LED3 LED4 LED5 */
          836  134   775   56   675   56   575   56   475   56   /* LED6 LED13 LED12 LED11 LED10 */
          375   56   275   56   175   56   175  156   275  156   /* LED9 LED8 LED7 LED14 LED15 */
          375  156   475  156   575  156   675  156   775  156   /* LED16 LED17 LED18 LED19 LED20 */
          775  256   675  256   575  256   475  256   375  256   /* LED27 LED26 LED25 LED24 LED23 */
          275  256   175  256   175  356   275  356   375  356   /* LED22 LED21 LED28 LED29 LED30 */
          475  356   575  356   675  356   775  356   /* LED31 LED32 LED33 LED34 */
    >;
};

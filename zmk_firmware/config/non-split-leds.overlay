/* Status indicator and SK6812 controls for standalone x7/x8. */

#include <dt-bindings/zmk/rgb.h>
#include <dt-bindings/zmk-matrix-lighting/matrix_lighting.h>
#include "indicator-test.overlay"
#include "nimh-battery-test.overlay"

&led_strip {
    chain-length = <38>;
};

&vbatt {
    series-cell-count = <1>;
};

&rgb_ug {
    compatible = "zmk,behavior-matrix-lighting";
    display-name = "Static Underglow";
    underglow-led-count = <6>;
    default-hue = <250>;
    default-saturation = <100>;
    default-backlight-brightness = <10>;
    default-underglow-brightness = <10>;
    default-backlight-enabled;
};

&maintenance_layer {
    bindings = <
&trans &bt_fb BT_SEL 0 &bt_fb BT_SEL 1 &bt_fb BT_SEL 2 &bt_fb BT_SEL 3 &bt_fb BT_SEL 4 &trans &trans
&rgb_ug ZMK_MATRIX_LIGHTING_BACKLIGHT_TOG &rgb_ug RGB_HUI &rgb_ug RGB_SAI &rgb_ug ZMK_MATRIX_LIGHTING_BACKLIGHT_BRI &rgb_ug ZMK_MATRIX_LIGHTING_UNDERGLOW_BRI &rgb_ug ZMK_MATRIX_LIGHTING_BACKLIGHT_LAYER_COLOR_TOG &trans &trans
&rgb_ug ZMK_MATRIX_LIGHTING_UNDERGLOW_TOG &rgb_ug RGB_HUD &rgb_ug RGB_SAD &rgb_ug ZMK_MATRIX_LIGHTING_BACKLIGHT_BRD &rgb_ug ZMK_MATRIX_LIGHTING_UNDERGLOW_BRD &rgb_ug ZMK_MATRIX_LIGHTING_UNDERGLOW_LAYER_COLOR_TOG &out OUT_TOG &out OUT_TOG
&ind_tog &rgb_ug ZMK_MATRIX_LIGHTING_AUTO_OFF_TOG &trans &trans &trans &trans &studio_unlock &studio_unlock
&bootloader &bt_fb BT_CLR
    >;
};

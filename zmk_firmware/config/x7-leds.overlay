/* Confirmed x7 status indicator and SK6812 controls. */

#include <dt-bindings/zmk/rgb.h>
#include <dt-bindings/zmk-matrix-lighting/matrix_lighting.h>
#include "indicator-test.overlay"
#include "nimh-battery-test.overlay"

/*
 * The x7 board carries 34 SK6812, not the 38 of the shield default: one
 * backlight column fewer, four LEDs fewer. The lighting module asserts that
 * led-positions covers exactly chain-length LEDs, so the strip has to be
 * shortened here rather than left at the x8 superset value.
 */
&led_strip {
    chain-length = <34>;
};

&vbatt {
    series-cell-count = <1>;
};

&rgb_ug {
    compatible = "zmk,behavior-matrix-lighting";
    display-name = "Static Underglow";
    underglow-led-count = <6>;
    matrix-columns = <7>;
    matrix-rows = <4>;
    /*
     * 34 LEDs in data-chain order: LED1 first. Generated with
     *   tools/gen_led_positions.py --pcb kicad-private/x7_panelize/x7.kicad_pcb
     *       --net <x7.net> --anchor SW1 --anchor-centre 175 75
     * The chain snakes: every backlight row runs opposite to the one above it,
     * so the reference designators and the chain order disagree from LED13 on.
     */
    led-positions = <
          114  134   114  225   114  316   836  316   836  225   /* LED1 LED2 LED3 LED4 LED5 */
          836  134   775   56   675   56   575   56   475   56   /* LED6 LED13 LED12 LED11 LED10 */
          375   56   275   56   175   56   175  156   275  156   /* LED9 LED8 LED7 LED14 LED15 */
          375  156   475  156   575  156   675  156   775  156   /* LED16 LED17 LED18 LED19 LED20 */
          775  256   675  256   575  256   475  256   375  256   /* LED27 LED26 LED25 LED24 LED23 */
          275  256   175  256   175  356   275  356   375  356   /* LED22 LED21 LED28 LED29 LED30 */
          475  356   575  356   675  356   775  356   /* LED31 LED32 LED33 LED34 */
    >;
    default-hue = <250>;
    default-saturation = <100>;
    default-backlight-brightness = <10>;
    default-underglow-brightness = <10>;
    default-backlight-enabled;
};

/*
 * The keymap stays the x8 superset - the shield scans 16 columns either way and
 * the x7 board simply leaves the eighth column of each half open - so the
 * maintenance layer is the same eight-wide table as the x8 image.
 */

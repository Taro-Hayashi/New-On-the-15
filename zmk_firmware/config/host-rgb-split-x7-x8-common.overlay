/* Host-visible x7-left + x8-right topology for the isolated split RGB trial. */

&rgb_ug {
    host-led-count = <72>;
    host-underglow-ranges = <0 6 34 6>;
    host-led-positions = <
          114  134   114  225   114  316   836  316   836  225
          836  134   775   56   675   56   575   56   475   56
          375   56   275   56   175   56   175  156   275  156
          375  156   475  156   575  156   675  156   775  156
          775  256   675  256   575  256   475  256   375  256
          275  256   175  256   175  356   275  356   375  356
          475  356   575  356   675  356   775  356
         1264  134  1264  225  1264  316  2086  316  2086  225
         2086  134  2025   56  1925   56  1825   56  1725   56
         1625   56  1525   56  1425   56  1325   56  1325  156
         1425  156  1525  156  1625  156  1725  156  1825  156
         1925  156  2025  156  2025  256  1925  256  1825  256
         1725  256  1625  256  1525  256  1425  256  1325  256
         1325  356  1425  356  1525  356  1625  356  1725  356
         1825  356  1925  356  2025  356
    >;
};

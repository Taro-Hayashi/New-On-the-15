## zmk_firmware/boards/shields/on_the_15/Kconfig.defconfig
```kconfig
if SHIELD_ON_THE_15

config ZMK_KEYBOARD_NAME
    default "On the 15 x7/x8"

config SPI
    default y

if ZMK_RGB_UNDERGLOW

config ZMK_RGB_UNDERGLOW_EXT_POWER
    default n

endif # ZMK_RGB_UNDERGLOW

if ZMK_MATRIX_LIGHTING

config ZMK_MATRIX_LIGHTING_SETTINGS_PATH
    default "onthe15/underglow_v8"

endif # ZMK_MATRIX_LIGHTING

endif
```

## zmk_firmware/boards/shields/on_the_15_split/Kconfig.shield
```kconfig
config SHIELD_ON_THE_15_SPLIT_LEFT
    def_bool $(shields_list_contains,on_the_15_split_left)

config SHIELD_ON_THE_15_SPLIT_RIGHT
    def_bool $(shields_list_contains,on_the_15_split_right)
```

## zmk_firmware/boards/shields/on_the_15_x15/Kconfig.defconfig
```kconfig
if SHIELD_ON_THE_15_X15

config ZMK_KEYBOARD_NAME
    default "On the 15 x15"

config SPI
    default y

if ZMK_RGB_UNDERGLOW

config ZMK_RGB_UNDERGLOW_EXT_POWER
    default n

endif # ZMK_RGB_UNDERGLOW

if ZMK_MATRIX_LIGHTING

config ZMK_MATRIX_LIGHTING_SETTINGS_PATH
    default "onthe15/underglow_v8"

endif # ZMK_MATRIX_LIGHTING

endif
```

## zmk_firmware/drivers/Kconfig
```kconfig
rsource "gpio/Kconfig"
rsource "status/Kconfig"
rsource "battery/Kconfig"
rsource "power/Kconfig"
rsource "lighting/Kconfig"
rsource "keymap_force_stock/Kconfig"
```

## zmk_firmware/drivers/battery/Kconfig
```kconfig
config ONTHE15_BATTERY_NIMH_DIAGNOSTIC
    bool "On the 15 NiMH battery monitor"
    default n
    select ADC
    select SENSOR
    help
      Read one or more series-connected Eneloop AAA cells through vbat_sense
      and estimate state of charge from the Panasonic BK-4MCC discharge curve.

config ONTHE15_BATTERY_SETTINGS_SPLIT_SYNC
    bool "Send battery settings from the split central to its peripherals"
    default y
    depends on ONTHE15_BATTERY_SETTINGS && ZMK_SPLIT
    select ZMK_SPLIT_RELAY_EVENT
    help
      Each half reads its own cell and warns about its own charge, so the
      chemistry curve and the warning switch have to hold on both. The battery
      behavior is global, so a key toggle reaches both, but a change made from
      Studio reaches only the central. This relays it, the same way the
      indicator and the lighting relay theirs.

config ONTHE15_BATTERY_SETTINGS
    bool "On the 15 battery warning and chemistry settings"
    default n
    depends on ONTHE15_BATTERY_NIMH_DIAGNOSTIC
    select SETTINGS
```

## zmk_firmware/drivers/gpio/Kconfig
```kconfig
config GPIO_SN74HC595_CHAIN
	bool "Daisy-chained SN74HC595 SPI GPIO expander"
	default y
	depends on DT_HAS_ONTHE15_SN74HC595_CHAIN_ENABLED
	depends on SPI
	help
	  GPIO driver for up to four daisy-chained 74HC595 shift registers on
	  one SPI bus. Pin 0 maps to QA of the register closest to the MCU,
	  matching the RMK Hc595Matrix column order.

config GPIO_SN74HC595_CHAIN_INIT_PRIORITY
	int "Init priority"
	default 85
	depends on GPIO_SN74HC595_CHAIN
```

## zmk_firmware/drivers/keymap_force_stock/Kconfig
```kconfig
config ONTHE15_KEYMAP_FORCE_STOCK
    bool "Discard any stored keymap at boot and run the compiled one"
    depends on ZMK_KEYMAP_SETTINGS_STORAGE
    default n
    help
      Hardware-test images want the deterministic compiled keymap (the shield's
      A-Z-in-physical-order layout), but ZMK_STUDIO_RPC hard-selects
      ZMK_KEYMAP_SETTINGS_STORAGE, so a board that already carries a saved
      keymap would boot into that instead. Enable this to call
      zmk_keymap_reset_settings() shortly after startup, which deletes the
      stored bindings, layer names and layer ordering and reloads the stock
      keymap - the same thing ZMK Studio's "restore stock keymap" does.

      Only the keymap is touched: lighting, battery, BLE bonds and every other
      settings subtree are left alone, unlike a full settings erase.

      Never enable this in a distributed or daily-use image: keymap edits made
      over Studio will not survive a reboot.
```

## zmk_firmware/drivers/lighting/Kconfig
```kconfig
config ONTHE15_LIGHTING_STARTUP
    bool "On the 15 power-up lighting intro"
    default n
    depends on ZMK_MATRIX_LIGHTING
    help
      Play the six-LED underglow ripple when the LED domain comes up, then
      hand over to the saved effect. The pattern assumes the On the 15 edge
      underglow: three LEDs on the left and three on the right, in symmetric
      pairs.
```

## zmk_firmware/drivers/power/Kconfig
```kconfig
config ONTHE15_POWER_SETTINGS
    bool "On the 15 runtime power settings"
    default n
    depends on ZMK_SLEEP
    help
      Store runtime idle and deep-sleep timeouts and apply them through the
      patched ZMK activity API used by the isolated DYA firmware.
```

## zmk_firmware/drivers/status/Kconfig
```kconfig
config ONTHE15_STATUS_INDICATOR
    bool "On the 15 two-LED status indicator"
    default n
    help
      Drive the P0.28 green and P0.29 red indicators from ZMK connection,
      battery, activity, and layer state.

config ONTHE15_STATUS_INDICATOR_SPLIT_SYNC
    bool "Send indicator settings from the split central to its peripherals"
    default y
    depends on ONTHE15_STATUS_INDICATOR && ZMK_SPLIT
    select ZMK_SPLIT_RELAY_EVENT
    help
      The ind_tog behavior is global, so toggling the connected indicator from
      a key reaches both halves on its own. A change made from Studio reaches
      only the central, which leaves the two indicators disagreeing. This
      relays the settings the same way the lighting module relays its own.

config ONTHE15_STATUS_INDICATOR_TEST_ALWAYS_ON
    bool "Hold both On the 15 status LEDs on for hardware tests"
    default n
    depends on ONTHE15_STATUS_INDICATOR
    help
      Ignore status patterns and continuously drive both indicator LEDs high.

config ONTHE15_LIGHTING
    bool "On the 15 lighting"
    default n
    select ZMK_MATRIX_LIGHTING
    select ONTHE15_LIGHTING_STARTUP
    help
      Turn on this keyboard's lighting: the reusable matrix lighting module
      plus the power-up intro. Enable ZMK_MATRIX_LIGHTING on its own for the
      module without the intro.

config ONTHE15_BT_FEEDBACK_BEHAVIOR
    bool "On the 15 Bluetooth feedback behavior"
    default y
    depends on !ZMK_SPLIT || ZMK_SPLIT_ROLE_CENTRAL
    help
      Wrap Bluetooth profile selection and clearing so x15 status LEDs can
      provide deterministic feedback without relying on ambiguous BLE events.
```

## zmk_firmware/dts/bindings/behaviors/onthe15,behavior-battery-settings.yaml
```yaml
description: On the 15 battery warning and chemistry settings
compatible: "onthe15,behavior-battery-settings"
include: one_param.yaml
```

## zmk_firmware/dts/bindings/behaviors/onthe15,behavior-bt-feedback.yaml
```yaml
description: Bluetooth profile operation with x15 status LED feedback

compatible: "onthe15,behavior-bt-feedback"

include: two_param.yaml
```

## zmk_firmware/dts/bindings/behaviors/onthe15,behavior-indicator-toggle.yaml
```yaml
description: On the 15 connected indicator toggle behavior

compatible: "onthe15,behavior-indicator-toggle"

include: zero_param.yaml
```

## zmk_firmware/dts/bindings/behaviors/onthe15,behavior-static-underglow.yaml
```yaml
description: On the 15 state-change-only underglow behavior

compatible: "onthe15,behavior-static-underglow"

include: two_param.yaml
```

## zmk_firmware/dts/bindings/behaviors/onthe15,behavior-status-settings.yaml
```yaml
description: On the 15 status indication switches

compatible: "onthe15,behavior-status-settings"

include: one_param.yaml
```

## zmk_firmware/dts/bindings/sensor/onthe15,battery-nimh-diagnostic.yaml
```yaml
description: On the 15 Eneloop AAA battery monitor

compatible: "onthe15,battery-nimh-diagnostic"

include: voltage-divider.yaml

properties:
  series-cell-count:
    type: int
    required: true
    description: Number of series-connected NiMH cells measured by the divider
```

## zmk_firmware/modules/onthe15-settings-reset/Kconfig
```kconfig
config ONTHE15_SETTINGS_RESET_TO_BOOTLOADER
    bool "Enter the UF2 bootloader after erasing ZMK settings"
    depends on ZMK_SETTINGS_RESET_ON_START
    default y
    help
      Reboot into the UF2 bootloader after ZMK has synchronously erased the
      settings partition during startup.
```

## zmk_firmware/modules/onthe15-studio/Kconfig
```kconfig
config ZMK_ONTHE15_STUDIO_RPC
    bool "Enable On the 15 custom Studio RPC"
    depends on ZMK_STUDIO
    help
      Enables the onthe15__studio custom RPC subsystem. Reads are public and
      settings mutations require Studio Unlock.

if ZMK_ONTHE15_STUDIO_RPC

config ZMK_STUDIO_RPC_TX_BUF_SIZE
    range 160 4096
    default 160

endif
```

## zmk_firmware/modules/zmk-feature-power-settings/Kconfig
```kconfig
config ZMK_POWER_SETTINGS
    bool "Reusable runtime power settings"
    default n
    depends on ZMK_SLEEP
    depends on SETTINGS
    help
      Provides validated runtime idle and deep-sleep timeout settings through
      the ZMK activity API. The settings subtree is configurable so existing
      firmware can retain its persistent storage format.

if ZMK_POWER_SETTINGS

config ZMK_POWER_SETTINGS_SETTINGS_PATH
    string "Zephyr settings subtree"
    default "zmk/power_settings_v1"
    help
      Persistent settings subtree without the trailing /state component.
      Keep this value stable after shipping firmware.

config ZMK_POWER_SETTINGS_SYNC_API
    bool "Enable split-ready synchronization contract"
    default n
    help
      Adds source-tagged snapshots, generations, change notifications, and
      deterministic reconnect conflict resolution. This does not enable or
      implement a split transport.

config ZMK_POWER_SETTINGS_SPLIT_SYNC
    bool "Carry the synchronization contract over the split transport"
    default y
    depends on ZMK_SPLIT
    select ZMK_POWER_SETTINGS_SYNC_API
    select ZMK_SPLIT_RELAY_EVENT
    help
      Sends the central's snapshot to its peripherals when the settings
      change, and lets a peripheral ask for one when it connects. Both halves
      sleep on their own timers, so without this a peripheral keeps the
      timeouts its firmware was built with. Conflict resolution is the one the
      sync API already defines.

config ZMK_POWER_SETTINGS_STUDIO_RPC
    bool "DYA Studio zmk__settings compatibility RPC"
    default n
    depends on ZMK_STUDIO
    select ZMK_POWER_SETTINGS_SYNC_API
    help
      Exposes the DYA Studio zmk__settings activity-settings contract as a
      thin write-through adapter over this module. No split transport is
      enabled by this option.

endif
```

## zmk_firmware/modules/zmk-feature-power-settings/dts/bindings/behaviors/zmk,behavior-power-settings.yaml
```yaml
description: Runtime idle and deep-sleep timeout keys

compatible: "zmk,behavior-power-settings"

include: one_param.yaml

properties:
  idle-step-ms:
    type: int
    default: 30000
    description: How far one idle timeout key moves the timeout
  deep-sleep-step-ms:
    type: int
    default: 300000
    description: How far one deep-sleep timeout key moves the timeout
```

/*
 * On the 15 v4 BLE split: x7 (left, central) + x8 (right, peripheral).
 * Each half scans its own 3 x 16 matrix; the combined keymap is 3 rows x
 * 32 columns with the right half at col-offset 16 (the RMK split firmware
 * used a 6 x 16 row-offset arrangement instead — same key set).
 */

#include <dt-bindings/zmk/matrix_transform.h>
#include "../on_the_15/on_the_15_common.dtsi"

/ {
    chosen {
        zmk,kscan = &kscan0;
        zmk,physical-layout = &default_layout;
    };

    default_transform: keymap_transform_0 {
        compatible = "zmk,matrix-transform";
        columns = <32>;
        rows = <3>;
        map = <
RC(0,0) RC(0,1) RC(0,2) RC(0,3) RC(0,4) RC(0,5) RC(0,6) RC(0,7) RC(0,8) RC(0,9) RC(0,10) RC(0,11) RC(0,12) RC(0,13) RC(0,14) RC(0,15) RC(0,16) RC(0,17) RC(0,18) RC(0,19) RC(0,20) RC(0,21) RC(0,22) RC(0,23) RC(0,24) RC(0,25) RC(0,26) RC(0,27) RC(0,28) RC(0,29) RC(0,30) RC(0,31)
RC(1,0) RC(1,1) RC(1,2) RC(1,3) RC(1,4) RC(1,5) RC(1,6) RC(1,7) RC(1,8) RC(1,9) RC(1,10) RC(1,11) RC(1,12) RC(1,13) RC(1,14) RC(1,15) RC(1,16) RC(1,17) RC(1,18) RC(1,19) RC(1,20) RC(1,21) RC(1,22) RC(1,23) RC(1,24) RC(1,25) RC(1,26) RC(1,27) RC(1,28) RC(1,29) RC(1,30) RC(1,31)
RC(2,0) RC(2,1) RC(2,2) RC(2,3) RC(2,4) RC(2,5) RC(2,6) RC(2,7) RC(2,8) RC(2,9) RC(2,10) RC(2,11) RC(2,12) RC(2,13) RC(2,14) RC(2,15) RC(2,16) RC(2,17) RC(2,18) RC(2,19) RC(2,20) RC(2,21) RC(2,22) RC(2,23) RC(2,24) RC(2,25) RC(2,26) RC(2,27) RC(2,28) RC(2,29) RC(2,30) RC(2,31)
        >;
    };

    default_layout: physical_layout_0 {
        compatible = "zmk,physical-layout";
        display-name = "On the 15";
        kscan = <&kscan0>;
        transform = <&default_transform>;
    };
};

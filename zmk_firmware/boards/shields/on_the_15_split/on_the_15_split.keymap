/*
 * Matrix-check keymap matching rmk_firmware/src/keymap_x15.rs layer 0
 * (the x7 + x8 check maps side by side). Position (0,0) on the left half
 * resets that half into the UF2 bootloader.
 */

#include <behaviors.dtsi>
#include <dt-bindings/zmk/keys.h>

/ {
    keymap {
        compatible = "zmk,keymap";

        default_layer {
            bindings = <
&bootloader &kp N2 &kp N3 &kp N4 &kp N5 &kp N6 &kp N7 &kp N8 &kp N9 &kp N0 &kp MINUS &kp EQUAL &kp LBKT  &kp RBKT  &kp BSLH &kp N1     &kp N1 &kp N2 &kp N3 &kp N4 &kp N5 &kp N6 &kp N7 &kp N8 &kp N9 &kp N0 &kp MINUS &kp EQUAL &kp LBKT  &kp RBKT  &kp BSLH &kp GRAVE
&kp Q       &kp W  &kp E  &kp R  &kp T  &kp Y  &kp U  &kp I  &kp O  &kp P  &kp SEMI  &kp SQT   &kp GRAVE &kp COMMA &kp DOT  &kp FSLH   &kp Q  &kp W  &kp E  &kp R  &kp T  &kp Y  &kp U  &kp I  &kp O  &kp P  &kp SEMI  &kp SQT   &kp GRAVE &kp COMMA &kp DOT  &kp FSLH
&kp A       &kp S  &kp D  &kp G  &kp H  &kp J  &kp K  &kp L  &kp Z  &kp X  &kp C     &kp V     &kp B     &kp N     &kp M    &kp F      &kp A  &kp S  &kp D  &kp G  &kp H  &kp J  &kp K  &kp L  &kp Z  &kp X  &kp C     &kp V     &kp B     &kp N     &kp M    &kp F
            >;
        };
    };
};

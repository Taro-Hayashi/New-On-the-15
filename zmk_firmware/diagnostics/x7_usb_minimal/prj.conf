## CMakeLists.txt
```
cmake_minimum_required(VERSION 3.20.0)
find_package(Zephyr REQUIRED HINTS $ENV{ZEPHYR_BASE})
project(x7_usb_minimal)

target_sources(app PRIVATE src/main.c)
```

## prj.conf
```kconfig
CONFIG_GPIO=y
CONFIG_SERIAL=n
CONFIG_CONSOLE=n
CONFIG_USB_DEVICE_STACK=n
CONFIG_USB_CDC_ACM=n
CONFIG_BUILD_OUTPUT_UF2=y
```

## usb-cdc.conf
```kconfig
CONFIG_SERIAL=y
CONFIG_CONSOLE=n
CONFIG_USB_DEVICE_STACK=y
CONFIG_USB_CDC_ACM=y
```

## boards/xiao_ble_nrf52840.overlay
```dts
/*
 * The ZMK nrf52840-nosd snippet expects the SoftDevice reservation to have
 * this label. Zephyr's standard XIAO BLE board names it reserved_partition_0.
 */
sd_partition: &reserved_partition_0 { };
```

## src/main.c
```c
#include <zephyr/kernel.h>
#include <zephyr/sys/util.h>

#include <hal/nrf_gpio.h>

#if IS_ENABLED(CONFIG_USB_DEVICE_STACK)
#include <zephyr/usb/usb_device.h>
#endif

#define X7_LED1 NRF_GPIO_PIN_MAP(0, 28)
#define X7_LED2 NRF_GPIO_PIN_MAP(0, 29)
#define XIAO_RED_LED NRF_GPIO_PIN_MAP(0, 26)
#define XIAO_GREEN_LED NRF_GPIO_PIN_MAP(0, 30)

int main(void)
{
    nrf_gpio_cfg_output(X7_LED1);
    nrf_gpio_cfg_output(X7_LED2);
    nrf_gpio_cfg_output(XIAO_RED_LED);
    nrf_gpio_cfg_output(XIAO_GREEN_LED);

    nrf_gpio_pin_clear(X7_LED1);
    nrf_gpio_pin_clear(X7_LED2);
    nrf_gpio_pin_set(XIAO_RED_LED);
    nrf_gpio_pin_set(XIAO_GREEN_LED);

#if IS_ENABLED(CONFIG_USB_DEVICE_STACK)
    if (usb_enable(NULL) == 0) {
        nrf_gpio_pin_set(X7_LED2);
        nrf_gpio_pin_clear(XIAO_GREEN_LED);
    }
#else
    nrf_gpio_pin_set(X7_LED2);
    nrf_gpio_pin_clear(XIAO_GREEN_LED);
#endif

    while (1) {
        nrf_gpio_pin_toggle(X7_LED1);
        nrf_gpio_pin_toggle(XIAO_RED_LED);
        k_msleep(500);
    }

    return 0;
}
```
